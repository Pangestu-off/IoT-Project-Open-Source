#include <SPI.h>
#include <Wire.h>
#include <Adafruit_GFX.h>
#include <Adafruit_SSD1306.h>

#define SCREEN_WIDTH 128 // OLED display width, in pixels
#define SCREEN_HEIGHT 64 // OLED display height, in pixels

// Declaration for an SSD1306 display connected to I2C (SDA, SCL pins)
#define OLED_RESET     4 // Reset pin # (or -1 if sharing Arduino reset pin)
Adafruit_SSD1306 display(SCREEN_WIDTH, SCREEN_HEIGHT, &Wire, OLED_RESET);

const unsigned char myLOGO [] PROGMEM = {
  0x00, 0x00, 0x00, 0x00, 0x00, 0x00, 0x00, 0x00, 0x00, 0x00, 0x00, 0x00, 0x00, 0x00, 0x00, 0x00, 
  0x00, 0x00, 0x00, 0x00, 0x00, 0x00, 0x00, 0x00, 0x00, 0x00, 0x00, 0x00, 0x00, 0x00, 0x00, 0x00, 
  0x00, 0x00, 0x00, 0x00, 0x00, 0x00, 0x00, 0x00, 0x00, 0x00, 0x00, 0x00, 0x00, 0x00, 0x00, 0x00, 
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  0x00, 0x00, 0x00, 0x00, 0x00, 0x00, 0x00, 0x00, 0x00, 0x00, 0x00, 0x00, 0x00, 0x00, 0x00, 0x00
};

const unsigned char myBitmap [] PROGMEM = {
  0x00, 0x00, 0x00, 0x00, 0x00, 0x00, 0x00, 0x00, 0x00, 0x00, 0x00, 0x00, 0x00, 0x00, 0x00, 0x00, 
  0x00, 0x00, 0x00, 0x00, 0x00, 0x00, 0x00, 0x00, 0x00, 0x00, 0x00, 0x00, 0x00, 0x00, 0x00, 0x00, 
  0x00, 0x00, 0x00, 0x00, 0x00, 0x00, 0x00, 0x00, 0x00, 0x00, 0x00, 0x00, 0x00, 0x00, 0x00, 0x00, 
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  0x00, 0x00, 0x00, 0x00, 0x00, 0x00, 0x00, 0x00, 0x00, 0x00, 0x00, 0x00, 0x00, 0x00, 0x00, 0x00
};


int R1 = 100;
int R2 = 1000;
int R3 = 10000;
long R4 = 100000;
long R5 = 1000000;
long Rn;
int D2 = 2;
int D3 = 3;
int D4 = 4;
int D5 = 5;
int D6 = 6;

float raw = 0;
float Vout = 0;
float Ru = 0;
int Analogohm = A0;

void setup() {
  Serial.begin(9600);

  
  if(!display.begin(SSD1306_SWITCHCAPVCC, 0x3C)) { 
    Serial.println(F("SSD1306 allocation failed"));
    for(;;); 
  }
  display.clearDisplay();
  display.drawBitmap(0,0, myLOGO, 128, 64, WHITE);
  display.display();
  delay(2000);
}


void loop() {

    pinMode(D2, OUTPUT);
    pinMode(D3, INPUT);
    pinMode(D4, INPUT);
    pinMode(D5, INPUT);
    pinMode(D6, INPUT);

    digitalWrite(D2, HIGH);
    raw = analogRead(Analogohm);
    Serial.println(raw);
    Serial.println("ref 1M");
    Rn = R5;

    if (raw < 350 || raw > 800){
      digitalWrite(D2, LOW);
      pinMode(D2, INPUT);
      pinMode(D3, OUTPUT);
      digitalWrite(D3, HIGH);
      raw = analogRead(Analogohm);
      Serial.println(raw);
      Serial.println("ref 100k");
      Rn = R4;

      if (raw < 350 || raw > 800){
        digitalWrite(D3, LOW);
        pinMode(D3, INPUT);
        pinMode(D4, OUTPUT);
        digitalWrite(D4, HIGH);
        raw = analogRead(Analogohm);
        Serial.println(raw);
        Serial.println("ref 10k");
        Rn = R3;

        if (raw < 350 || raw > 800){
          digitalWrite(D4, LOW);
          pinMode(D4, INPUT);
          pinMode(D5, OUTPUT);
          digitalWrite(D5, HIGH);
          raw = analogRead(Analogohm);
          Serial.println(raw);
          Serial.println("ref 1000");
          Rn = R2;

          if (raw < 350 || raw > 800){
            digitalWrite(D5, LOW);
            pinMode(D5, INPUT);
            pinMode(D6, OUTPUT);
            digitalWrite(D6, HIGH);
            raw = analogRead(Analogohm);
            Serial.println(raw);
            Serial.println("ref 100");
            Rn = R1;
          }
        }
      }
    }

    Vout = 5*(raw/1024);
    Ru = (Rn*Vout)/(5-Vout);
    if (Ru < 10 || Ru < 70) {
      Ru = 10 *round(Ru/10);
    } else if (Ru < 100 || Ru < 700){
      Ru = 100 *round(Ru/100);
    } else if (Ru < 1000 || Ru < 7000){
      Ru = 1000 *round(Ru/1000);
    } else if (Ru < 10000 || Ru < 70000){
      Ru = 10000 *round(Ru/10000);
    } else if (Ru < 100000 || Ru < 700000){
      Ru = 100000 *round(Ru/100000);
    } else if (Ru < 1000000 || Ru < 7000000){
      Ru = 1000000 *round(Ru/1000000);
    }
    Resistance(Ru);
    delay(1000);
}

void Resistance(long Ru) {
  display.clearDisplay();

  display.setTextSize(1);            
  display.setTextColor(WHITE);        
  display.setCursor(0,0);             
  display.println(F("Hey there, "));
  display.println(F("the Resistor value is"));
  display.setCursor(20,25);
  display.setTextSize(2);             
  display.setTextColor(WHITE);        
  display.print(Ru);
  display.print(F(" Ohm"));
  display.drawBitmap(0,0, myBitmap, 128, 64, WHITE);
  display.display();
  delay(2000);
}
